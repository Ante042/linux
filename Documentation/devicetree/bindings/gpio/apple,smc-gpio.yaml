## Documentation/devicetree/bindings/gpio/apple,smc-gpio.yaml
```yaml
# SPDX-License-Identifier: (GPL-2.0-only OR BSD-2-Clause)
%YAML 1.2
---
$id: http://devicetree.org/schemas/gpio/apple,smc-gpio.yaml#
$schema: http://devicetree.org/meta-schemas/core.yaml#

title: Apple Mac System Management Controller GPIO

maintainers:
  - Sven Peter <sven@kernel.org>

description:
  Apple Mac System Management Controller GPIO block.

properties:
  compatible:
    enum:
      - apple,smc-gpio
      - apple,smc-low-gpio
      - apple,smc-pcio-gpio

  apple,output-commands:
    $ref: /schemas/types.yaml#/definitions/uint64-array
    minItems: 1
    maxItems: 64
    description: |
      Board-specific pcIO output command templates in GPIO index order.
      Each template is the eight-byte argument from the native pKW8
      platform function. Its low 16 bits must be zero and are replaced
      with the requested logical output value. Remaining fields are
      opaque PMU command data. This interface supports outputs only;
      electrical state readback is not available.

  gpio-controller: true

  '#gpio-cells':
    const: 2

required:
  - compatible
  - gpio-controller
  - '#gpio-cells'

allOf:
  - if:
      properties:
        compatible:
          const: apple,smc-pcio-gpio
    then:
      required:
        - apple,output-commands
    else:
      properties:
        apple,output-commands: false

additionalProperties: false
```

## arch/arm64/Kconfig.debug
```kconfig
# SPDX-License-Identifier: GPL-2.0-only

config PID_IN_CONTEXTIDR
	bool "Write the current PID to the CONTEXTIDR register"
	help
	  Enabling this option causes the kernel to write the current PID to
	  the CONTEXTIDR register, at the expense of some additional
	  instructions during context switch. Say Y here only if you are
	  planning to use hardware trace tools with this kernel.

config DEBUG_EFI
	depends on EFI && DEBUG_INFO
	bool "UEFI debugging"
	help
	  Enable this option to include EFI specific debugging features into
	  the kernel that are only useful when using a debug build of the
	  UEFI firmware

config ARM64_RELOC_TEST
	depends on m
	tristate "Relocation testing module"

source "drivers/hwtracing/coresight/Kconfig"

config AURORA_EL1_SYSREG_PROBE
	bool "Aurora bounded EL1 sysreg read diagnostic"
	depends on ARCH_APPLE && DEBUG_KERNEL
	default n
	help
	  Build a read-only, fixed-register diagnostic for the experimental
	  x1n1 SPTM hypervisor. The aurora_el1_sysregs=1 boot parameter is
	  also required. Only use with the matching opt-in HV probe handler.
	  Undefined reads recover only at explicitly generated probe PCs.
	  No candidate system register is written. Say N for normal kernels.
```
