// SPDX-License-Identifier: GPL-2.0-only OR MIT
/* Diagnostic-only J700 comparison; not a production power-policy change. */
/dts-v1/;
/plugin/;
/ {
    fragment@0 {
        target-path = "/soc/usb@40a280000";
        __overlay__ {
            snps,dis_u3_susphy_quirk;
        };
    };
};
